## Documentation/devicetree/bindings/arm/transtrack.yaml
```yaml
# SPDX-License-Identifier: GPL-2.0
%YAML 1.2
---
$id: http://devicetree.org/schemas/arm/renesas.yaml#
$schema: http://devicetree.org/meta-schemas/core.yaml#

title: Transtrack SBC

maintainers:
  - Muchlis Kurnia <muchlis@laxa.one>

properties:
  $nodename:
    const: '/'
  compatible:
    oneOf:
      - description: Transtrack Custom RZG2LC 512MB DDR4
        items:
          - enum:
              - transtrack,rzg2lc-custom
          - const: renesas,r9a07g044


additionalProperties: true

...
```
