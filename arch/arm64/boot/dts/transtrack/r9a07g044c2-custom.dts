// SPDX-License-Identifier: (GPL-2.0-only OR BSD-2-Clause)
/*
 * Device Tree Source for the RZ/G2LC SMARC EVK board
 *
 * Copyright (C) 2021 Renesas Electronics Corp.
 */

/dts-v1/;
#include "../renesas/r9a07g044c2.dtsi"
#include "rzg2lc-custom.dtsi"

/ {
	model = "Transtrack Custom RZG2LC Board";
	compatible = "transtrack,rzg2lc-custom", "renesas,r9a07g044c2", "renesas,r9a07g044";
};
